## manifest/west.yml
```yaml
# Copyright (C) Intel Corporation, 2022
# SPDX-License-Identifier: MIT
#
# West manifest for multi-repo management
# See also: https://docs.zephyrproject.org/latest/guides/west/manifest.html

manifest:

  remotes:
    - name: github
      url-base: https://github.com
    - name: gitlab
      url-base: https://gitlab.com

  # put workspace repo at the top - this only works with `west init -l`
  self:
    path: .
    import: manifest/imports/

  projects:

    - name: kafl
      remote: github
      repo-path: IntelLabs/kafl.fuzzer
      revision: master
      groups:
        - kafl_fuzzer

    - name: examples
      remote: github
      repo-path: IntelLabs/kafl.targets
      revision: master
      path: examples
      groups:
        - examples

    - name: host_kernel
      remote: github
      repo-path: nyx-fuzz/KVM-Nyx
      revision: kvm-nyx-5.10.73
      path: kafl/nyx/kvm
      groups:
        - host_kernel

    - name: qemu
      repo-path: IntelLabs/kafl.qemu
      remote: github
      revision: kafl_stable
      path: kafl/nyx/qemu
      groups:
        - qemu

    - name: libxdc
      remote: github
      repo-path: IntelLabs/kafl.libxdc
      revision: kafl_stable
      path: kafl/nyx/libxdc
      groups:
        - qemu

    - name: capstone
      remote: github
      repo-path: aquynh/capstone
      revision: v4
      path: kafl/nyx/capstone
      groups:
        - qemu

    - name: radamsa
      remote: gitlab
      repo-path: akihe/radamsa
      revision: develop
      path: kafl/radamsa
      groups:
        - radamsa

  group-filter: [-host_kernel, -examples]
```

## west.yml
```yaml
# West manifest for multi-repo management
#
# Configure custom branches and keep track in a repo of your choice.
#
# By default, west checks out a detached HEAD to avoid touching any local branches.
# To work on sub-projects, pull/extend branches as you like and use west update -k:
# https://docs.zephyrproject.org/latest/guides/west/built-in.html#west-update
#

manifest:

  remotes:
    - name: sandbox
      url-base: https://github.com/intel-sandbox
    - name: github
      url-base: https://github.com
    - name: gitlab
      url-base: https://gitlab.com

  self:
    path: kafl
    west-commands: scripts/west_commands.yml
    import: .submanifests

  projects:

    - name: targets
      repo-path: IntelLabs/kafl.targets
      remote: github
      revision: master
      groups:
        - targets

    - name: kvm
      repo-path: nyx-fuzz/KVM-Nyx
      remote: github
      revision: kvm-nyx-5.10.73
      groups:
        - host_kernel

    - name: qemu
      repo-path: IntelLabs/kafl.qemu
      remote: github
      revision: kafl_stable
      groups:
        - qemu

    - name: libxdc
      repo-path: IntelLabs/kafl.libxdc
      remote: github
      revision: kafl_stable
      groups:
        - qemu

    - name: capstone
      repo-path: aquynh/capstone
      remote: github
      revision: v4
      groups:
        - qemu

    - name: radamsa
      remote: gitlab
      repo-path: akihe/radamsa
      revision: develop
      groups:
        - radamsa

  group-filter: [-host_kernel]
```
