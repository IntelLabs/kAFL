## CMakeLists.txt
```
# SPDX-License-Identifier: Apache-2.0

cmake_minimum_required(VERSION 3.13.1)

include($ENV{ZEPHYR_BASE}/cmake/app/boilerplate.cmake NO_POLICY_SCOPE)

project(kafl_agent)
target_sources(app PRIVATE src/main.c)
set_property(TARGET app PROPERTY C_STANDARD 99)

# Select a fuzzing target at a time, e.g. ``cmake ../ -D KAFL_TEST=y''
target_sources_ifdef(KAFL_TEST  app PRIVATE src/target_test.c)
target_sources_ifdef(KAFL_FS    app PRIVATE src/target_fs.c)
target_sources_ifdef(KAFL_JSON  app PRIVATE src/target_json.c)
```

## prj.conf
```kconfig
#CONFIG_FLASH_BASE_ADDRESS=0x100000
#CONFIG_SRAM_BASE_ADDRESS=0x500000
#
CONFIG_SRAM_SIZE=8192
#CONFIG_FLASH_SIZE=2048

# need to accomodate PAYLOAD_SIZE (~128kb)
CONFIG_MAIN_STACK_SIZE=262144

# enable available protections to help us catch bugs
CONFIG_ASSERT=y
CONFIG_HW_STACK_PROTECTION=y
CONFIG_STACK_CANARIES=y

# disable spectre/meltdown mitigations for kAFL build
CONFIG_X86_KPTI=n

# build with address sanitizer - only available for CONFIG_ARCH_POSIX
#CONFIG_ASAN=y

# UMODE test?
CONFIG_USERSPACE=n

# JSON test
CONFIG_JSON_LIBRARY=y

# FS test
CONFIG_DISK_ACCESS=y
CONFIG_FILE_SYSTEM=y
CONFIG_FAT_FILESYSTEM_ELM=y
```

## src/main.c
```c
/*
 * Copyright 2020 Intel Corporation
 *
 * SPDX-License-Identifier: Apache-2.0
 */

#include <zephyr.h>
#include <kernel.h>
#include <fatal.h>
#include <sys/check.h>

#include <stdlib.h>
#include <stdint.h>
#include <stdbool.h>
#include <string.h>

#define _GNU_SOURCE
#include "kafl_user.h"
#include "target.h"

#ifdef DEBUG
static void test_panic(void)
{
	printk("kAFL test_panic()\n");

	/* panic hook captures all of the following */
	k_panic();
	//k_oops();
	//__ASSERT(0 == 1, "0 == 1");
	//target_entry("KERNELAFLAA", strlen("KERNELAFLAA"));
	//target_entry("SERGEJABC", strlen("SERGEJABC"));

	printk("Warning - this code should not be reached!\n");
}
#endif

static void agent_init(void *panic_handler, void *kasan_handler)
{
	printk("Initiate fuzzer handshake...\n");

	kAFL_hypercall(HYPERCALL_KAFL_ACQUIRE, 0);
	kAFL_hypercall(HYPERCALL_KAFL_RELEASE, 0);

	/* submit panic and optionally kasan handlers for qemu override */
	kAFL_hypercall(HYPERCALL_KAFL_SUBMIT_PANIC, panic_handler);

	if (kasan_handler) {
		kAFL_hypercall(HYPERCALL_KAFL_SUBMIT_KASAN, kasan_handler);
	}
}

static void agent_run(void)
{
	/* 
	 * Heap allocation causes an interesting bug where agent crashes without proper
	 * detection/handling by the fuzzer..would be good to fix/report any such issues
	 * to make porting to new targets easier and don't waste cpu on broken threads..
	 */
#ifdef PAYLOAD_ON_HEAP
	kAFL_payload* payload_buffer = k_malloc(PAYLOAD_SIZE);
	if (!payload_buffer)
		return;
#else
	uint8_t buffer[PAYLOAD_SIZE];
	kAFL_payload* payload_buffer = (kAFL_payload*)buffer;
#endif

	kAFL_hypercall(HYPERCALL_KAFL_GET_PAYLOAD, payload_buffer);
	kAFL_hypercall(HYPERCALL_KAFL_SUBMIT_CR3, 0);

	target_init();

	while (1) {
		kAFL_hypercall(HYPERCALL_KAFL_NEXT_PAYLOAD, 0);
		kAFL_hypercall(HYPERCALL_KAFL_ACQUIRE, 0);
#ifdef DEBUG
		test_panic();
#endif
		target_entry(payload_buffer->data, payload_buffer->size);

		kAFL_hypercall(HYPERCALL_KAFL_RELEASE, 0);
	}
}

/*
 * That function is weak symbol on Zephyr, just override it with our
 * function to notify KVM through hypercall.
 */
void k_sys_fatal_error_handler(unsigned int reason, const z_arch_esf_t *esf)
{
	switch (reason) {
		case K_ERR_CPU_EXCEPTION:
		case K_ERR_KERNEL_OOPS:
		case K_ERR_KERNEL_PANIC:
			kAFL_hypercall(HYPERCALL_KAFL_PANIC, 0);
			break;
		default:
			kAFL_hypercall(HYPERCALL_KAFL_KASAN, 0);
			break;
	}

	k_fatal_halt(reason);
}

void main(void)
{
	printk("kAFL Hello World! %s\n\n", CONFIG_BOARD);
	
	// skip rewrite in favor of custom k_sys_fatal_error_handler()
	void* panic_handler = NULL;
	void* kasan_handler = NULL;

	printk("Kernel Panic Handler Address:\t%p\n", panic_handler);

	if (kasan_handler){
		printk("Kernel KASAN Handler Address:\t%p\n", kasan_handler);
	}

	agent_init(panic_handler, kasan_handler);
	agent_run();
}
```

## src/kafl_user.h
```c
/*
 * Copyright 2020 Sergej Schumilo, Cornelius Aschermann
 * Copyright 2020 Intel Corporation
 * 
 * SPDX-License-Identifier: Apache-2.0
 */ 

/*
 * kAFL hypercall API, adapted from targets/kafl_user.h
 */

#ifndef KAFL_USER_H
#define KAFL_USER_H

#include <stdint.h>

#define HYPERCALL_KAFL_RAX_ID				0x01f
#define HYPERCALL_KAFL_ACQUIRE				0
#define HYPERCALL_KAFL_GET_PAYLOAD			1
#define HYPERCALL_KAFL_GET_PROGRAM			2
#define HYPERCALL_KAFL_GET_ARGV				3
#define HYPERCALL_KAFL_RELEASE				4
#define HYPERCALL_KAFL_SUBMIT_CR3			5
#define HYPERCALL_KAFL_SUBMIT_PANIC			6
#define HYPERCALL_KAFL_SUBMIT_KASAN			7
#define HYPERCALL_KAFL_PANIC				8
#define HYPERCALL_KAFL_KASAN				9
#define HYPERCALL_KAFL_LOCK					10
#define HYPERCALL_KAFL_INFO					11
#define HYPERCALL_KAFL_NEXT_PAYLOAD			12
#define HYPERCALL_KAFL_PRINTF				13
#define HYPERCALL_KAFL_PRINTK_ADDR			14
#define HYPERCALL_KAFL_PRINTK				15

/* user space only hypercalls */
#define HYPERCALL_KAFL_USER_RANGE_ADVISE	16
#define HYPERCALL_KAFL_USER_SUBMIT_MODE		17
#define HYPERCALL_KAFL_USER_FAST_ACQUIRE	18
/* 19 is already used for exit reason KVM_EXIT_KAFL_TOPA_MAIN_FULL */
#define HYPERCALL_KAFL_USER_ABORT			20
#define HYPERCALL_KAFL_TIMEOUT				21

#define PAYLOAD_SIZE						(128 << 10)				/* up to 128KB payloads */
#define PROGRAM_SIZE						(128 << 20)				/* kAFL supports 128MB programm data */
#define INFO_SIZE        					(128 << 10)				/* 128KB info string */

typedef struct{
	int32_t size;
	uint8_t data[PAYLOAD_SIZE-sizeof(int32_t)-sizeof(uint8_t)];
	uint8_t redqueen_mode;
} kAFL_payload;

typedef struct{
	uint64_t ip[4];
	uint64_t size[4];
	uint8_t enabled[4];
} kAFL_ranges;

#define KAFL_MODE_64	0
#define KAFL_MODE_32	1
#define KAFL_MODE_16	2

//#define KAFL_SIM
#ifndef KAFL_SIM
static inline void kAFL_hypercall(uint32_t p1, void* p2)
{
	uint32_t nr = HYPERCALL_KAFL_RAX_ID;
	asm ("vmcall"
			: : "a"(nr), "b"(p1), "c"(p2));
}
#else
static kAFL_payload *sim_payload;
static char* sim_inputs[] = {
	"0",
	"ABCDEFGHIJKLMNOPQRSTUVWXYZ",
	"0123456789",
	"ABCDEFG",
	"abcdefghijklmnopqrstuvwxyz",
	"ABCDEFGHIJKLMNOPQRSTUVWXYZ",
	"AAAAAAAAAAAAAAAAAA",
	"SERGEJAFLABCDEFG",
	"",
	"AAAAAAAAAAAAAAAAAA",
	"KASANABCDEFG0123",
	"",
	"AAAAAAAAAAAAAAAAAA",
	"",
	"KERNELAFLABCDEFG",
};
static int sim_idx = 0;
static inline void kAFL_hypercall(uint32_t p1, void* p2)
{
	switch(p1) {
		case HYPERCALL_KAFL_ACQUIRE:
			printk("hypercall: KAFL_AQUIRE()\n");
			break;
		case HYPERCALL_KAFL_GET_PAYLOAD:
			printk("hypercall: KAFL_GET_PAYLOAD(%p)\n", p2);
			sim_payload = (kAFL_payload*)p2;
			break;
		case HYPERCALL_KAFL_GET_PROGRAM:
			printk("hypercall: KAFL_GET_PROGRAM()\n");
			break;
		case HYPERCALL_KAFL_GET_ARGV:
			printk("hypercall: KAFL_GET_ARGV()\n");
			break;
		case HYPERCALL_KAFL_RELEASE:
			printk("hypercall: KAFL_RELEASE()\n");
			break;
		case HYPERCALL_KAFL_SUBMIT_CR3:
			printk("hypercall: KAFL_CR3(%p)\n", p2);
			break;
		case HYPERCALL_KAFL_SUBMIT_PANIC:
			printk("hypercall: KAFL_SUBMIT_PANIC(%p)\n", p2);
			break;
		case HYPERCALL_KAFL_SUBMIT_KASAN:
			printk("hypercall: KAFL_SUBMIT_KASAN(%p)\n", p2);
			break;
		case HYPERCALL_KAFL_PANIC:
			printk("hypercall: KAFL_isPANIC()\n");
			break;
		case HYPERCALL_KAFL_KASAN:
			printk("hypercall: KAFL_isKASAN()\n");
			break;
		case HYPERCALL_KAFL_LOCK:
			printk("hypercall: KAFL_LOCK()\n");
			break;
		case HYPERCALL_KAFL_INFO:
			printk("hypercall: KAFL_INFO()\n");
			printk("%s\n", (char*)p2);
			break;
		case HYPERCALL_KAFL_NEXT_PAYLOAD:
			printk("hypercall: KAFL_NEXT_PAYLOAD()\n");
			sim_idx = (sim_idx + 1) % sizeof(*sim_inputs);
			sim_payload->size = strlen(sim_inputs[sim_idx]);
			memcpy(sim_payload->data, sim_inputs[sim_idx], sim_payload->size);
			break;
		default:
			printk("Invalid hypercall!\n");
	}
}

#endif /* KAFL_SIM */
#endif /* KAFL_USER_H */
```

## src/target.h
```c
/*
 * Copyright 2020 Intel Corporation
 * SPDX-License-Identifier: Apache-2.0
 */

#ifndef _KAFL_VULN_TEST_H_
#define _KAFL_VULN_TEST_H_

#include <sys/types.h>

void target_init();

ssize_t target_entry(const char *buf, size_t len);


#endif /* _KAFL_VULN_TEST_H_ */
```

## src/target_fs.c
```c
/*
 * Zephyr FS fuzzing sample
 *
 * This is not really working. Can you fix it?
 *
 * lsdir() function and other snippets taken from Zephyr RTOS project
 * samples/subsys/fs/fat_fs/src/main.c
 *
 * Copyright 2019-2020 Intel Corporation
 * SPDX-License-Identifier: Apache-2.0
 */

#include <zephyr.h>
#include <kernel.h>
#include <fs/fs.h>
#include <ff.h>

#include <string.h>
#include <sys/types.h>

static FATFS fat_fs;
static struct fs_mount_t mp = {
	.type = FS_FATFS,
	.fs_data = &fat_fs,
};

static const char *disk_mount_pt = "/SD:";

void target_init() {};

static int lsdir(const char *path)
{
    int res;
    struct fs_dir_t dirp;
    static struct fs_dirent entry;

    /* Verify fs_opendir() */
    res = fs_opendir(&dirp, path);
    if (res) {
        printk("Error opening dir %s [%d]\n", path, res);
        return res;
    }

    printk("\nListing dir %s ...\n", path);
    for (;;) {
        /* Verify fs_readdir() */
        res = fs_readdir(&dirp, &entry);

        /* entry.name[0] == 0 means end-of-dir */
        if (res || entry.name[0] == 0) {
            break;
        }

        if (entry.type == FS_DIR_ENTRY_DIR) {
            printk("[DIR ] %s\n", entry.name);
        } else {
            printk("[FILE] %s (size = %zu)\n",
                entry.name, entry.size);
        }
    }

    /* Verify fs_closedir() */
    res = fs_closedir(&dirp);

    return res;
}

ssize_t target_entry(void *buf, size_t len)
{
	int rc = 0;

	mp.fs_data = buf;
	mp.mnt_point = disk_mount_pt;

	int res = fs_mount(&mp);

	if (res == FR_OK) {
		printk("Disk mounted.\n");
		lsdir(disk_mount_pt);
		fs_unmount(&mp);
	} else {
		printk("Error mounting disk.\n");
	}

	return rc;
}
```

## src/target_json.c
```c
/*
 * Zephyr json fuzzing sample
 *
 * This file is in part based on Zephyr RTOS project
 * tests/lib/json/src/main.c
 *
 * Copyright 2020 Intel Corporation
 * SPDX-License-Identifier: Apache-2.0
 */

#include <zephyr.h>
#include <kernel.h>
#include <data/json.h>

#include <string.h>
#include <sys/types.h>

/*
 * Structs and description are part of Zephyr's test
 */
struct test_nested {
	int nested_int;
	bool nested_bool;
	const char *nested_string;
};

struct test_struct {
	const char *some_string;
	int some_int;
	bool some_bool;
	struct test_nested some_nested_struct;
	int some_array[16];
	size_t some_array_len;
	bool another_bxxl;               /* JSON field: "another_b!@l" */
	bool if_;                        /* JSON: "if" */
	int another_array[10];           /* JSON: "another-array" */
	size_t another_array_len;
	struct test_nested xnother_nexx; /* JSON: "4nother_ne$+" */
};

static const struct json_obj_descr nested_descr[] = {
	JSON_OBJ_DESCR_PRIM(struct test_nested, nested_int, JSON_TOK_NUMBER),
	JSON_OBJ_DESCR_PRIM(struct test_nested, nested_bool, JSON_TOK_TRUE),
	JSON_OBJ_DESCR_PRIM(struct test_nested, nested_string,
			JSON_TOK_STRING),
};

static const struct json_obj_descr description[] = {
	JSON_OBJ_DESCR_PRIM(struct test_struct, some_string, JSON_TOK_STRING),
	JSON_OBJ_DESCR_PRIM(struct test_struct, some_int, JSON_TOK_NUMBER),
	JSON_OBJ_DESCR_PRIM(struct test_struct, some_bool, JSON_TOK_TRUE),
	JSON_OBJ_DESCR_OBJECT(struct test_struct, some_nested_struct,
			nested_descr),
	JSON_OBJ_DESCR_ARRAY(struct test_struct, some_array,
			16, some_array_len, JSON_TOK_NUMBER),
	JSON_OBJ_DESCR_PRIM_NAMED(struct test_struct, "another_b!@l",
			another_bxxl, JSON_TOK_TRUE),
	JSON_OBJ_DESCR_PRIM_NAMED(struct test_struct, "if",
			if_, JSON_TOK_TRUE),
	JSON_OBJ_DESCR_ARRAY_NAMED(struct test_struct, "another-array",
			another_array, 10, another_array_len,
			JSON_TOK_NUMBER),
	JSON_OBJ_DESCR_OBJECT_NAMED(struct test_struct, "4nother_ne$+",
			xnother_nexx, nested_descr),
};

void target_init() {};

ssize_t target_entry(const char *buf, size_t len)
{
	int ret;
	struct test_struct desc;

	ret = json_obj_parse((char *)buf, len, description,
			ARRAY_SIZE(description), &desc);

	return (ssize_t)ret;
}
```

## src/target_test.c
```c
/*
 * Zephyr TEST fuzzing sample target
 *
 * Based on kAFL kafl_vuln_test module
 *
 * Copyright 2017 Sergej Schumilo
 * Copyright 2019-2020 Intel Corporation
 *
 * SPDX-License-Identifier: Apache-2.0
 */

#include <zephyr.h>
#include <kernel.h>

#include <string.h>
#include <sys/types.h>

const size_t INPUT_LENGTH = 32;

void target_init() {};

ssize_t target_entry(const char *buf, size_t len)
{
	char input[INPUT_LENGTH];

	if (len >= INPUT_LENGTH) {
		return -EFAULT;
	}
	
	memcpy(input, buf, len);

	if(input[0] == 'K')
		if(input[1] == 'E')
			if(input[2] == 'R')
				if(input[3] == 'N')
					if(input[4] == 'E')
						if(input[5] == 'L')
							if(input[6] == 'A')
								if(input[7] == 'F')
									if(input[8] == 'L') {
										printk("BUG: KERNELAFL\n");
										k_panic(); /* boom! bug incoming... */
									}

	if(input[0] == 'S')
		if(input[1] == 'E')
			if(input[2] == 'R')
				if(input[3] == 'G')
					if(input[4] == 'E')		
						if(input[5] == 'J') {
							printk("BUG: SERGEJ\n");
							k_oops();
						}

	/* memory corruption */
	if(input[0] == 'K'){
    	if(input[1] == 'A'){
        	if(input[2] == 'S'){
            	if(input[3] == 'A'){
                	if(input[4] == 'N') {
						printk("BUG: KASAN\n");
						k_oops();
					}
				}
        	}
        }
	}

	if (0 == strncmp(input, "RedQueen", strlen("RedQueen"))) {
		printk("BUG: RedQueen\n");
		k_oops();
	}

	return len;
}
```
